## firmware/main/Kconfig.projbuild
```kconfig
menu "Ruth Speaker Configuration"

    menu "WiFi"
        config WIFI_SSID
            string "WiFi SSID"
            default "myssid"
        config WIFI_PASSWORD
            string "WiFi password"
            default "mypassword"
    endmenu

    menu "Backend"
        config RUTH_SERVER_URL
            string "Voice converse_raw endpoint"
            default "http://192.168.1.10:8000/api/v1/voice/converse_raw"
            help
                Полный URL до POST /api/v1/voice/converse_raw на сервере.
                Для HTTPS используй https://... и поправь TLS-настройки.

        config RUTH_JWT
            string "JWT bearer token"
            default "PASTE_JWT_HERE"
            help
                Получаем через POST /api/v1/auth/login.
                Срок жизни — 30 минут (см. ACCESS_TOKEN_EXPIRE_MINUTES в .env).
                Для production надо хранить в NVS и обновлять при 401.
    endmenu

    menu "Activation mode"
        choice RUTH_ACTIVATION
            prompt "Как пользователь активирует разговор"
            default RUTH_ACTIVATION_WAKEWORD
            help
                WAKEWORD — esp-sr WakeNet, голосовая активация.
                BUTTON   — BOOT-кнопка (GPIO0), удобно для отладки.

            config RUTH_ACTIVATION_WAKEWORD
                bool "Wake word (esp-sr WakeNet)"
            config RUTH_ACTIVATION_BUTTON
                bool "Push-to-talk (BOOT button)"
        endchoice

        config RUTH_RECORD_MAX_SECONDS
            int "Максимальная длительность реплики, сек"
            default 8
            range 2 30
    endmenu

endmenu
```

## firmware/sdkconfig.defaults
```kconfig
# Целевой чип
CONFIG_IDF_TARGET="esp32s3"

# Octal PSRAM 8 MB (N16R8)
CONFIG_SPIRAM=y
CONFIG_SPIRAM_MODE_OCT=y
CONFIG_SPIRAM_SPEED_80M=y
CONFIG_SPIRAM_USE_MALLOC=y
CONFIG_SPIRAM_TRY_ALLOCATE_WIFI_LWIP=y
CONFIG_SPIRAM_MALLOC_ALWAYSINTERNAL=16384

# Flash 16 MB
CONFIG_ESPTOOLPY_FLASHSIZE_16MB=y
CONFIG_ESPTOOLPY_FLASHSIZE="16MB"
CONFIG_PARTITION_TABLE_CUSTOM=y
CONFIG_PARTITION_TABLE_CUSTOM_FILENAME="partitions.csv"
CONFIG_PARTITION_TABLE_FILENAME="partitions.csv"

# CPU 240 MHz
CONFIG_ESP_DEFAULT_CPU_FREQ_MHZ_240=y

# HTTPS / TLS
CONFIG_MBEDTLS_CERTIFICATE_BUNDLE=y
CONFIG_MBEDTLS_DYNAMIC_BUFFER=y
CONFIG_ESP_HTTPS_OTA_ALLOW_HTTP=n
CONFIG_ESP_TLS_INSECURE=y
CONFIG_ESP_TLS_SKIP_SERVER_CERT_VERIFY=y

# WiFi
CONFIG_ESP_WIFI_STATIC_RX_BUFFER_NUM=10
CONFIG_ESP_WIFI_DYNAMIC_RX_BUFFER_NUM=32

# Логи
CONFIG_LOG_DEFAULT_LEVEL_INFO=y

# esp-sr (включается через managed_components)
CONFIG_USE_WAKENET=y
CONFIG_SR_WN_WN9_HIESP=y
CONFIG_SR_MN_CN_NONE=y
CONFIG_SR_MN_EN_NONE=y
```
